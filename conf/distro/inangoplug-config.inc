## conf/distro/inangoplug-config.inc
```bitbake
CONFIG_OVS_INFRASTRUCTURE_ENABLE ?= ""
CONFIG_INANGO_SO_SERVER ?= ""
CONFIG_OVS_INFRASTRUCTURE_SSL_RUNTIME_DIR ?= "/nvram/openvswitch"
CONFIG_OVS_INFRASTRUCTURE_SSL_DEFAULT_DIR ?= "/etc/inangoplug"
CONFIG_OVS_INFRASTRUCTURE_SC_PRIVKEY ?= ""
CONFIG_OVS_INFRASTRUCTURE_SC_CERT ?= ""
CONFIG_OVS_INFRASTRUCTURE_CA_CERT ?= ""
```

## conf/distro/inangoplug-infra.inc
```bitbake
INANGOPLUG_SRCREV_pn-inangoplug-rsc ?= "4bb0590cb9d6e6c33531c1c3cf5c8a40915dd3c2"
INANGOPLUG_SRCREV_pn-inangoplug-chandler ?= "f9107d07880f31d950ce25092dea2c1b602296ec"
INANGOPLUG_SRCREV_pn-inangoplug-rsc-proxy ?= "2271a215b113e5e16d8a815dc9739b4aa6555d42"
INANGOPLUG_SRCREV_pn-inangoplug-pp-acceleration-mod ?= "b8247d147d08516c0cd158f6f0daa0b95038ab41"
INANGOPLUG_SRCREV_pn-inangoplug-mngm ?= "0eca0d6b7558a3dec80d51b7ec061bcb1e0c107f"
INANGOPLUG_SRCREV_pn-ovs-brcompat ?= "258b78277ea4339d211f917c091c74b3f78d315e"
```

## conf/layer.conf
```bitbake
# We have a conf and classes directory, add to BBPATH
BBPATH .= ":${LAYERDIR}"

BBFILES += "${LAYERDIR}/recipes-*/*/*.bb \
 ${LAYERDIR}/recipes-*/*/*.bbappend"
BB_DANGLINGAPPENDS_WARNONLY = "1"

BBFILE_COLLECTIONS += "inangoplug"
BBFILE_PATTERN_inangoplug = "^${LAYERDIR}/"
BBFILE_PRIORITY_inangoplug = "11"

LAYERSERIES_COMPAT_inangoplug = "dunfell morty"

MACHINEOVERRIDES_append = "${@':puma7arm' if d.getVar('CONFIG_ARM', True) == 'y' else ''}"

LICENSE_PATH += "${LAYERDIR}/files/additional-licenses"

DISTRO_FEATURES_append = " inangoplug"

IMAGE_INSTALL_append = " \
                         packagegroup-inangoplug \
                       "

INANGOPLUG_SRC_URI ?= "git://github.com/InangoSystems/${BPN}.git;protocol=https;nobranch=1"
include conf/distro/inangoplug-infra.inc
require conf/distro/inangoplug-config.inc
```
